// A scripted stand-in for the Spotify client: a demo playlist that plays, skips, queues and remembers
// history, so every part of the UI can be shown without a network or an account.
#include "spotify.h"
#include <cstdio>
#include <set>
#include <vector>

namespace {

struct DemoTrack {
    const char *id;
    const char *title;
    const char *artist;
    const char *album;
    const char *albumId;
    const char *art;  // file in sim/art
    uint32_t durationMs;
};

// Fictional tracks; the art is generated by sim/make_demo_art.py (replace the files to use your own).
const DemoTrack TRACKS[] = {
    {"t1", "Neon Harbour", "The Midnight Static", "Harbour Lights", "a1", "1.jpg", 214000},
    {"t2", "Paper Satellites", "Juniper Vale", "Low Orbit", "a2", "2.jpg", 187000},
    {"t3", "Glasshouse Summer", "Coral & The Tides", "Glasshouse", "a3", "3.jpg", 241000},
    {"t4", "Static on the Line", "The Midnight Static", "Harbour Lights", "a1", "1.jpg", 199000},
    {"t5", "Northern Fields", "Ostara", "Wide Open", "a4", "4.jpg", 263000},
    {"t6", "Velvet Hour", "Juniper Vale", "Low Orbit", "a2", "2.jpg", 225000},
    {"t7", "Copper Skies", "Ash & Ember", "Kiln", "a5", "5.jpg", 178000},
};
constexpr int TRACK_COUNT = sizeof(TRACKS) / sizeof(TRACKS[0]);

struct DemoDevice {
    const char *id;
    const char *name;
    bool volumeAllowed;
};
const DemoDevice DEVICES[] = {
    {"d1", "Living Room Speaker", true},
    {"d2", "Phone", false},  // phones usually refuse remote volume: shows the greyed-out buttons
    {"d3", "Kitchen Display", true},
};

const char *PLAYLISTS[] = {"Morning Focus", "Late Night Drive", "Sunday Slow", "Workout Mix", "Road Trip", "Rainy Day"};

int current = 0;
bool playing = true;
uint32_t positionMs = 30000;
uint32_t positionStamp = 0;
int volume = 60;
int device = 0;
bool shuffle = false;
RepeatMode repeat = REPEAT_OFF;
std::set<int> liked = {2};
std::vector<int> history = {6, 5};
String message;
uint32_t messageUntil = 0;

ListData lists[LIST_KIND_COUNT];
int pendingKind = -1;
uint32_t pendingAt = 0;

std::vector<uint8_t> artBytes;
int artShown = -1;

uint32_t position() { return positionMs + (playing ? millis() - positionStamp : 0); }

void setPosition(uint32_t ms) {
    positionMs = ms;
    positionStamp = millis();
}

void playIndex(int index, uint32_t startMs = 0) {
    if (index != current) {
        history.insert(history.begin(), current);
        if (history.size() > 20) history.pop_back();
    }
    current = (index + TRACK_COUNT) % TRACK_COUNT;
    playing = true;
    setPosition(startMs);
}

void advance(int step) {
    if (step < 0 && position() > 3000) {
        setPosition(0);  // like Spotify: "previous" first restarts the track
        return;
    }
    playIndex(current + step);
}

int findTrack(const String &id) {
    for (int i = 0; i < TRACK_COUNT; i++) {
        if (id == TRACKS[i].id) return i;
    }
    return -1;
}

String line(int i) { return String(TRACKS[i].title) + " - " + TRACKS[i].artist; }

void finishList(int kind) {
    ListData &l = lists[kind];
    l.items.clear();
    if (kind == LIST_DEVICES) {
        for (int i = 0; i < 3; i++) {
            ListItem item;
            item.id = DEVICES[i].id;
            item.name = DEVICES[i].name;
            item.active = i == device;
            l.items.push_back(item);
        }
    } else if (kind == LIST_PLAYLISTS) {
        for (int i = 0; i < 6; i++) {
            ListItem item;
            item.id = String("p") + String(i);
            item.name = PLAYLISTS[i];
            l.items.push_back(item);
        }
        l.next = l.total = 6;
    } else if (kind == LIST_RECENT) {
        for (int i : history) {
            ListItem item;
            item.id = TRACKS[i].id;
            item.name = line(i);
            item.context = String("spotify:album:") + TRACKS[i].albumId;
            l.items.push_back(item);
        }
    }
    l.status = LIST_READY;
    l.version++;
}

} // namespace

// Called by the simulator's main loop: advances the track and finishes list "requests".
void fake_spotify_tick() {
    if (playing && position() >= TRACKS[current].durationMs) {
        if (repeat == REPEAT_TRACK) {
            setPosition(0);
        } else {
            advance(shuffle ? 1 + (int)(millis() % (TRACK_COUNT - 1)) : 1);
        }
    }
    // Lists arrive a moment after they are requested, like over the network.
    if (pendingKind >= 0 && millis() - pendingAt > 350) {
        finishList(pendingKind);
        pendingKind = -1;
    }
}

void spotify_get_state(PlayerState &s) {
    const DemoTrack &t = TRACKS[current];
    s = PlayerState();
    s.active = true;
    s.playing = playing;
    s.trackId = t.id;
    s.title = t.title;
    s.artist = t.artist;
    s.album = t.album;
    s.albumId = t.albumId;
    s.albumType = "album";
    s.releaseDate = "2026-03-14";
    s.trackNumber = 1 + current % 10;
    s.totalTracks = 10;
    s.durationMs = t.durationMs;
    s.progressMs = position();
    s.stamp = millis();
    s.deviceName = DEVICES[device].name;
    s.volumeAllowed = DEVICES[device].volumeAllowed;
    s.volume = s.volumeAllowed ? volume : 100;
    s.shuffle = shuffle;
    s.repeat = repeat;
    s.liked = liked.count(current) ? 1 : 0;
    s.artUrl = t.art;
    s.upNext = line((current + 1) % TRACK_COUNT);
    if (!history.empty()) s.previous = line(history.front());
    if ((int32_t)(millis() - messageUntil) < 0) s.message = message;
}

void spotify_send(SpotifyCmd cmd) {
    switch (cmd) {
    case CMD_PLAY_PAUSE:
        setPosition(position());
        playing = !playing;
        break;
    case CMD_NEXT:
        advance(1);
        break;
    case CMD_PREV:
        advance(-1);
        break;
    case CMD_VOL_UP:
    case CMD_VOL_DOWN:
        if (DEVICES[device].volumeAllowed) volume = constrain(volume + (cmd == CMD_VOL_UP ? 10 : -10), 0, 100);
        break;
    case CMD_SHUFFLE:
        shuffle = !shuffle;
        break;
    case CMD_REPEAT:
        repeat = (RepeatMode)((repeat + 1) % 3);
        break;
    case CMD_LIKE:
        if (!liked.erase(current)) liked.insert(current);
        break;
    default:
        break;
    }
}

void spotify_seek(uint32_t ms) { setPosition(ms); }

void spotify_request_list(ListKind kind, uint32_t, const String &) {
    lists[kind].status = LIST_LOADING;
    lists[kind].items.clear();
    lists[kind].version++;
    pendingKind = kind;
    pendingAt = millis();
}

void spotify_select(ListKind kind, const String &id) {
    if (kind == LIST_DEVICES) {
        for (int i = 0; i < 3; i++) {
            if (id == DEVICES[i].id) device = i;
        }
    } else {
        playIndex(id.length() > 1 ? (id[1] - '0') % TRACK_COUNT : 0);
    }
}

void spotify_play_track(const String &trackId, const String &, uint32_t startMs) {
    int i = findTrack(trackId);
    if (i >= 0) playIndex(i, startMs);
}

void spotify_get_list(ListKind kind, ListData &out) { out = lists[kind]; }

uint32_t spotify_list_version(ListKind kind) { return lists[kind].version; }

void spotify_get_queue(std::vector<String> &out) {
    out.clear();
    for (int i = 1; i <= 10; i++) out.push_back(line((current + i) % TRACK_COUNT));
}

bool spotify_art_begin_read() {
    if (artShown == current) return false;
    artShown = current;
    artBytes.clear();
    String path = String("sim/art/") + TRACKS[current].art;
    FILE *f = fopen(path.c_str(), "rb");
    if (!f) return false;
    uint8_t buf[4096];
    size_t n;
    while ((n = fread(buf, 1, sizeof(buf), f)) > 0) artBytes.insert(artBytes.end(), buf, buf + n);
    fclose(f);
    return !artBytes.empty();
}

const uint8_t *spotify_art_data(size_t &size) {
    size = artBytes.size();
    return artBytes.data();
}

void spotify_art_end_read() {}
